## config/boards/shields/cassini_left_encoder/Kconfig.shield
```kconfig
config SHIELD_CASSINI_LEFT_ENCODER
    def_bool $(shields_list_contains,cassini_left_encoder)
```

## config/boards/shields/right_half_test/Kconfig.defconfig
```kconfig
if SHIELD_RIGHT_HALF_TEST

config ZMK_POINTING
    default y

config PMW3610_ALT
    default y

endif
```

## config/boards/shields/right_half_test/Kconfig.shield
```kconfig
config SHIELD_RIGHT_HALF_TEST
    def_bool $(shields_list_contains,right_half_test)
```

## config/boards/shields/wolfie_display_bus/Kconfig.shield
```kconfig
config SHIELD_WOLFIE_DISPLAY_BUS
    def_bool $(shields_list_contains,wolfie_display_bus)
```

## config/boards/shields/wolfie_display_diag/Kconfig.defconfig
```kconfig
if SHIELD_WOLFIE_DISPLAY_DIAG

config ZMK_KEYBOARD_NAME
    default "Wolfie Eye Test"

endif
```

## config/boards/shields/wolfie_display_diag/Kconfig.shield
```kconfig
config SHIELD_WOLFIE_DISPLAY_DIAG
    def_bool $(shields_list_contains,wolfie_display_diag)
```

## config/boards/shields/wolfie_keys_eye_pmw_safe/Kconfig.shield
```kconfig
config SHIELD_WOLFIE_KEYS_EYE_PMW_SAFE
    def_bool $(shields_list_contains,wolfie_keys_eye_pmw_safe)
```

## config/boards/shields/wolfie_keys_eye_qwerty/Kconfig.shield
```kconfig
config SHIELD_WOLFIE_KEYS_EYE_QWERTY
    def_bool $(shields_list_contains,wolfie_keys_eye_qwerty)
```

## config/boards/shields/wolfie_keys_eye_test/Kconfig.shield
```kconfig
config SHIELD_WOLFIE_KEYS_EYE_TEST
    def_bool $(shields_list_contains,wolfie_keys_eye_test)
```

## config/boards/shields/wolfie_left_corne/Kconfig.shield
```kconfig
config SHIELD_WOLFIE_LEFT_CORNE
    def_bool $(shields_list_contains,wolfie_left_corne)
```

## config/boards/shields/wolfie_left_matrix_test/Kconfig.shield
```kconfig
config SHIELD_WOLFIE_LEFT_MATRIX_TEST
    def_bool $(shields_list_contains,wolfie_left_matrix_test)
```

## config/boards/shields/wolfie_pmw3610_4ms/Kconfig.shield
```kconfig
config SHIELD_WOLFIE_PMW3610_4MS
    def_bool $(shields_list_contains,wolfie_pmw3610_4ms)
```

## config/boards/shields/wolfie_split/Kconfig.shield
```kconfig
config SHIELD_WOLFIE_SPLIT_RIGHT
    def_bool $(shields_list_contains,wolfie_split_right)

config SHIELD_WOLFIE_SPLIT_LEFT
    def_bool $(shields_list_contains,wolfie_split_left)
```
