/* Diagnostic-only PMW3610 high-performance sampling override.
 * Added as a SECOND shield after wolfie_split_right, so Zephyr loads this
 * file automatically without any EXTRA_DTC_OVERLAY_FILE path argument.
 * Higher active-mode power consumption is possible.
 */
&trackball {
    force-awake;
    force-awake-4ms-mode;
};
